## Firmware/RoboCYD/sdkconfig.defaults
```kconfig
CONFIG_FREERTOS_HZ=1000

# RoboCYD TFT_eSPI configuration
CONFIG_TFT_ILI9341_2_DRIVER=y
CONFIG_TFT_HSPI_PORT=y

CONFIG_TFT_MISO=12
CONFIG_TFT_MOSI=13
CONFIG_TFT_SCLK=14

CONFIG_TFT_CS=15
CONFIG_TFT_DC=2
CONFIG_TFT_RST=-1

CONFIG_TFT_SPI_FREQUENCY=55000000
CONFIG_TFT_SPI_READ_FREQ=20000000

# RoboCYD backlight: GPIO21, active HIGH
CONFIG_ENABLE_BL=y
CONFIG_TFT_BL=21
CONFIG_TFT_BACKLIGHT_ON_HIGH=y
# RoboCYD ILI9341_2 requires BGR colour order
CONFIG_TFT_BGR_ORDER=y

CONFIG_TFT_LOAD_GLCD=y
CONFIG_TFT_LOAD_FONT2=y
CONFIG_TFT_LOAD_FONT4=y
CONFIG_TFT_LOAD_FONT6=y
CONFIG_TFT_LOAD_FONT7=y
CONFIG_TFT_LOAD_FONT8=y

# Match the partition table already installed by PlatformIO
CONFIG_PARTITION_TABLE_CUSTOM=y
CONFIG_PARTITION_TABLE_CUSTOM_FILENAME="partitions_ota.csv"
CONFIG_PARTITION_TABLE_FILENAME="partitions_ota.csv"

# RoboCYD physical flash size
CONFIG_ESPTOOLPY_FLASHSIZE_4MB=y
CONFIG_ESPTOOLPY_FLASHSIZE="4MB"
```
